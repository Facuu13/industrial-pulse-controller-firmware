## firmware/sdkconfig.defaults
```kconfig
CONFIG_LOG_DEFAULT_LEVEL_INFO=y

# Watchdogs (base industrial)
CONFIG_ESP_TASK_WDT=y
CONFIG_ESP_TASK_WDT_TIMEOUT_S=10
CONFIG_ESP_INT_WDT=y

# Brownout
CONFIG_ESP_BROWNOUT_DET=y
```
